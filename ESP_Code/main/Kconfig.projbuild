## ESP_Code/main/Kconfig.projbuild
```kconfig
menu "Microphone Uploader"

config MIC_SAMPLE_RATE_HZ
	int "Microphone sample rate (Hz)"
	default 16000
	range 1000 48000
	help
		Sample rate used by the I2S microphone capture path.

config MIC_UPLOAD_WINDOW_MS
	int "Audio upload window (milliseconds)"
	default 10000
	range 1 60000
	help
		Maximum audio capture window used to size the static upload buffer.

endmenu
```
